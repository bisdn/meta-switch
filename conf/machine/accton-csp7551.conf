## conf/machine/accton-csp7551.conf
```bitbake
#@TYPE: Machine
#@NAME: accton-csp7551

#@DESCRIPTION: Machine configuration for accton-csp7551 systems

PREFERRED_PROVIDER_virtual/kernel ?= "linux-yocto-onl"
PREFERRED_VERSION_linux-yocto-onl ?= "6.1%"

KMACHINE:accton-csp7551 = "x86_64-intel"
KERNEL_FEATURES += "\
    bsp/x86_64-intel \
"

DEFAULTTUNE ?= "corei7-64"

# https://git.yoctoproject.org/poky/tree/meta/conf/machine/include?h=kirkstone
require conf/machine/include/x86/tune-corei7.inc
require conf/machine/include/x86/x86-base.inc

# https://github.com/bisdn/meta-open-network-linux/blob/master/conf/machine/include/onl.inc
require conf/machine/include/onl.inc

BISDN_SWITCH_IMAGE_EXTRA_INSTALL:remove = " \
    baseboxd \
    ofagent \
    ofdpa \
    ofdpa-grpc \
    ofdpa-tools \
    onl \
    python3-ofdpa \
"

# Allow configuration of BMC via ipmitool
BISDN_SWITCH_IMAGE_EXTRA_INSTALL:append = " \
    ipmitool \
"

# add development tools
BISDN_SWITCH_IMAGE_EXTRA_INSTALL:append = " \
    fping \
    iperf3 \
    net-tools \
    screen \
    openvswitch \
"

MACHINE_FEATURES += "pcbios efi"
MACHINE_FEATURES:remove = "alsa"

PLATFORM_VENDOR = "accton"
BISDN_ONIE_MACHINE = "csp7551"

ONIE_VENDOR = "accton"
ONIE_MACHINE_TYPE = "csp7551"

MACHINE_EXTRA_RDEPENDS += " \
    accton-csp7551-cpld-mod \
    accton-csp7551-fpga-mod \
    accton-csp7551-sfp-mod \
    platform-onl-init \
"

# Let platform init script load modules as needed
KERNEL_MODULE_PROBECONF = "fpga_driver i2c-i801"
module_conf_i2c-i801 = "blacklist i2c-i801"
module_conf_fpga_driver = "blacklist fpga_driver"

# Firmware needed by qat and ice kernel modules (from poky's linux-firmware)
MACHINE_EXTRA_RDEPENDS += " \
    linux-firmware-qat \
    linux-firmware-qat-license \
    linux-firmware-ice \
    linux-firmware-ice-license \
"
```
